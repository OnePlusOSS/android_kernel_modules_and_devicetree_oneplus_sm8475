/dts-v1/;
/plugin/;
#include <dt-bindings/oplus/hw-id.h>
#include "../display/cape-sde-display-mtp-overlay.dts"
//#include "waipio_display_overlay_common.dtsi"
#include "jennie_21606_display_overlay_common.dtsi"
/* #if defined(CONFIG_PXLW_IRIS) */
#include "../display/pxlw/pxlw-iris7.dtsi"
#include "../display/pxlw/dsi-panel-pxlw.dtsi"
/* #endif */

&sdhc_2 {
	status = "disabled";
	qcom,vdd-io-voltage-level = <1800000 1800000>;
};

/ {
    oplus,project-id = <21606 21738>;
    oplus,hw-id = <OPLUS_EVB1 OPLUS_EVB2 OPLUS_T0 OPLUS_EVT1 OPLUS_EVT2 OPLUS_EVT3 OPLUS_DVT1 OPLUS_DVT2 OPLUS_DVT3 OPLUS_PVT1 OPLUS_MP1 OPLUS_MP2 OPLUS_MP3>;
};
